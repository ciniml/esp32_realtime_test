## station/main/Kconfig.projbuild
```kconfig
menu "Example Configuration"

    config ESP_WIFI_SSID
        string "WiFi SSID"
        default "myssid"
        help
            SSID (network name) for the example to connect to.

    config ESP_WIFI_PASSWORD
        string "WiFi Password"
        default "mypassword"
        help
            WiFi password (WPA or WPA2) for the example to use.

    config ESP_MAXIMUM_RETRY
        int "Maximum retry"
        default 5
        help
            Set the Maximum retry to avoid station reconnecting to the AP unlimited when the AP is really inexistent.
    config ENABLE_WIFI
        bool "Enable Wi-Fi"
        default y

    choice TARGET_TIMER
        prompt "Target timer implementation to measure performance"
        help
            Target timer implementation to measure performance.
        config TARGET_TIMER_HARDWARE
            bool "Hardware Timer"
        config TARGET_TIMER_HIGH_RES
            bool "High Resolution Timer"
    endchoice
    choice TARGET_HARDWARE_TIMER_GROUP
        prompt "Target hardware timer group"
        depends on TARGET_TIMER_HARDWARE
        config TARGET_HARDWARE_TIMER_GROUP_0
            bool "GROUP0"
        config TARGET_HARDWARE_TIMER_GROUP_1
            bool "GROUP1"
    endchoice

    config PLACE_CALLBACK_ON_IRAM
        bool "Place callbacks on IRAM"
        default y

    config HARDWARE_TIMER_TASK_PRIORITY
        int "Hardware timer task priority"
        depends on TARGET_TIMER_HARDWARE
        default 24

    config HARDWARE_TIMER_TASK_CPU
        int "Hardware timer task CPU"
        depends on TARGET_TIMER_HARDWARE
        range 0 1
        default 1
    
    config DUMP_RAW_DATA
        bool "Dump raw measurement data"
        default n
endmenu
```
